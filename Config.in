## Config.in
```kconfig
source "$BR2_EXTERNAL_TI_PATH/package/ti-lvgl-demo/Config.in"
source "$BR2_EXTERNAL_TI_PATH/package/ti-img-rogue-driver/Config.in"
source "$BR2_EXTERNAL_TI_PATH/package/ti-img-rogue-umlibs/Config.in"
source "$BR2_EXTERNAL_TI_PATH/package/ti-img-rogue-mesa/Config.in"
# source "$BR2_EXTERNAL_TI_PATH/package/gfxbench5-bins/Config.in"
```

## configs/ti_release_beaglebone_green_eco_defconfig
```kconfig
BR2_arm=y
BR2_cortex_a8=y
BR2_ARM_FPU_VFPV3=y
BR2_PACKAGE_HOST_LINUX_HEADERS_CUSTOM_6_12=y
BR2_TOOLCHAIN_BUILDROOT_CXX=y
BR2_GLOBAL_PATCH_DIR="$(BR2_EXTERNAL_TI_PATH)/board/ti/common/patches"
BR2_DOWNLOAD_FORCE_CHECK_HASHES=y
BR2_TARGET_GENERIC_HOSTNAME="beaglebone-green-eco"
BR2_ROOTFS_DEVICE_CREATION_DYNAMIC_EUDEV=y
BR2_ROOTFS_OVERLAY="$(BR2_EXTERNAL_TI_PATH)/board/ti/beaglebone-green-eco/rootfs-overlay"
BR2_ROOTFS_POST_BUILD_SCRIPT="$(BR2_EXTERNAL_TI_PATH)/board/ti/beaglebone-green-eco/post-build.sh"
BR2_ROOTFS_POST_IMAGE_SCRIPT="support/scripts/genimage.sh"
BR2_ROOTFS_POST_IMAGE_SCRIPT_ARGS="-c $(BR2_EXTERNAL_TI_PATH)/board/ti/common/am33xx/genimage_ti.cfg"
BR2_LINUX_KERNEL=y
BR2_LINUX_KERNEL_CUSTOM_GIT=y
BR2_LINUX_KERNEL_CUSTOM_REPO_URL="https://git.ti.com/git/ti-linux-kernel/ti-linux-kernel.git"
BR2_LINUX_KERNEL_CUSTOM_REPO_VERSION="09.02.00.010"
BR2_LINUX_KERNEL_DEFCONFIG="omap2plus"
BR2_LINUX_KERNEL_DTS_SUPPORT=y
BR2_LINUX_KERNEL_INTREE_DTS_NAME="ti/omap/am335x-evm ti/omap/am335x-bone ti/omap/am335x-boneblack ti/omap/am335x-bonegreen ti/omap/am335x-evmsk ti/omap/am335x-boneblue ti/omap/am335x-boneblack-wireless ti/omap/am335x-bonegreen-wireless ti/omap/am335x-bonegreen-eco"
BR2_LINUX_KERNEL_NEEDS_HOST_OPENSSL=y
BR2_PACKAGE_BUSYBOX_SHOW_OTHERS=y
BR2_PACKAGE_ALSA_UTILS=y
BR2_PACKAGE_ALSA_UTILS_AMIXER=y
BR2_PACKAGE_ALSA_UTILS_APLAY=y
BR2_PACKAGE_GIT=y
BR2_PACKAGE_KMOD=y
BR2_PACKAGE_KMOD_TOOLS=y
BR2_PACKAGE_XZ=y
BR2_PACKAGE_MEMTESTER=y
BR2_PACKAGE_DROPBEAR=y
BR2_PACKAGE_MOSQUITTO=y
BR2_PACKAGE_BASH=y
BR2_TARGET_ROOTFS_EXT2=y
BR2_TARGET_ROOTFS_EXT2_4=y
BR2_TARGET_ROOTFS_EXT2_SIZE="512M"
BR2_TARGET_UBOOT=y
BR2_TARGET_UBOOT_BUILD_SYSTEM_KCONFIG=y
BR2_TARGET_UBOOT_CUSTOM_GIT=y
BR2_TARGET_UBOOT_CUSTOM_REPO_URL="https://git.ti.com/git/ti-u-boot/ti-u-boot.git"
BR2_TARGET_UBOOT_CUSTOM_REPO_VERSION="09.02.00.010"
BR2_TARGET_UBOOT_BOARD_DEFCONFIG="am335x_evm"
BR2_TARGET_UBOOT_NEEDS_DTC=y
BR2_TARGET_UBOOT_NEEDS_OPENSSL=y
BR2_TARGET_UBOOT_NEEDS_GNUTLS=y
# BR2_TARGET_UBOOT_FORMAT_BIN is not set
BR2_TARGET_UBOOT_FORMAT_IMG=y
BR2_TARGET_UBOOT_SPL=y
BR2_TARGET_UBOOT_SPL_NAME="MLO"
BR2_PACKAGE_HOST_DOSFSTOOLS=y
BR2_PACKAGE_HOST_GENIMAGE=y
BR2_PACKAGE_HOST_KMOD_XZ=y
BR2_PACKAGE_HOST_MTOOLS=y
BR2_PACKAGE_K3CONF=n
```

## package/ti-img-rogue-driver/Config.in
```kconfig
config BR2_PACKAGE_TI_IMG_ROGUE_DRIVER
	bool "ti-img-rogue-driver"
	depends on BR2_LINUX_KERNEL
	depends on BR2_aarch64
	help
	  PowerVR Rogue GPU kernel module for AM62x SoCs.

	  Enables GPU hardware support on AM62x boards.
	  Configured for wrynose release with Kernel 6.18
	  and PowerVR SDK version 26.1.6967606.

	  This is an out-of-tree kernel module that must be compiled
	  against the kernel build directory.

	  https://git.ti.com/git/graphics/ti-img-rogue-driver.git

if BR2_PACKAGE_TI_IMG_ROGUE_DRIVER

config BR2_PACKAGE_TI_IMG_ROGUE_DRIVER_DEBUG
	bool "Build debug version"
	default n
	help
	  Build with debug symbols and optimizations disabled.
	  Produces larger .ko file but allows kernel debugging.

endif
```

## package/ti-img-rogue-mesa/Config.in
```kconfig
config BR2_PACKAGE_TI_IMG_ROGUE_MESA
	bool "ti-img-rogue-mesa"
	depends on BR2_PACKAGE_TI_IMG_ROGUE_UMLIBS
	select BR2_PACKAGE_HAS_LIBEGL
	select BR2_PACKAGE_HAS_LIBGBM
	select BR2_PACKAGE_LIBGBM_HAS_FEATURE_DMA_BUF
	select BR2_PACKAGE_LIBGBM_HAS_FEATURE_FORMAT_MODIFIER_PLANE_COUNT
	select BR2_PACKAGE_HAS_LIBGLES
	select BR2_PACKAGE_EXPAT
	select BR2_PACKAGE_LIBDRM
	select BR2_PACKAGE_ZLIB
	select BR2_PACKAGE_WAYLAND_PROTOCOLS if BR2_PACKAGE_WAYLAND
	help
	  TI PowerVR Rogue Mesa shim. Provides EGL/GBM/GLES via Mesa's
	  "pvr" gallium driver, which dlopen()s libpvr_dri_support.so
	  from ti-img-rogue-umlibs at runtime. Required for glmark2 and
	  any other EGL/GBM-based GPU client on the Rogue OOT stack.

if BR2_PACKAGE_TI_IMG_ROGUE_MESA
config BR2_PACKAGE_PROVIDES_LIBEGL
	default "ti-img-rogue-mesa"
config BR2_PACKAGE_PROVIDES_LIBGBM
	default "ti-img-rogue-mesa"
config BR2_PACKAGE_PROVIDES_LIBGLES
	default "ti-img-rogue-mesa"
endif
```

## package/ti-img-rogue-umlibs/Config.in
```kconfig
config BR2_PACKAGE_TI_IMG_ROGUE_UMLIBS
	bool "ti-img-rogue-umlibs"
	depends on BR2_LINUX_KERNEL
	depends on BR2_aarch64
	depends on BR2_PACKAGE_TI_IMG_ROGUE_DRIVER
	help
	  PowerVR Rogue GPU userspace libraries (EGL/GLESv2/GBM) for
	  AM62x SoCs.

	  Provides the proprietary Imagination Technologies userspace
	  libraries needed to actually render on the PowerVR Rogue GPU.
	  The ti-img-rogue-driver kernel module alone only provides device
	  access - it cannot render anything by itself.

	  Configured for wrynose release with Kernel 6.18 and PowerVR SDK
	  version 26.1.6967606, matching ti-img-rogue-driver.

	  https://git.ti.com/git/graphics/ti-img-rogue-umlibs.git

if BR2_PACKAGE_TI_IMG_ROGUE_UMLIBS

config BR2_PACKAGE_TI_IMG_ROGUE_UMLIBS_DEBUG
	bool "Install debug build"
	default n
	help
	  Install the debug variant of the userspace libraries instead
	  of release.

endif
```
